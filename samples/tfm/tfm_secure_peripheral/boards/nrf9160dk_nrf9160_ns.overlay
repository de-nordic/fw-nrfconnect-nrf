/* Copyright (c) 2022 Nordic Semiconductor ASA
 *
 * SPDX-License-Identifier: LicenseRef-Nordic-5-Clause
 */

&pinctrl {
	spi3_default_alt: spi3_default_alt {
		group1 {
			psels = <NRF_PSEL(SPIM_SCK, 0, 13)>,
				<NRF_PSEL(SPIM_MOSI, 0, 11)>;
		};
	};
};

&spi3 {
	/* Disabled in non-secure image. */
	status = "disabled";
	pinctrl-0 = <&spi3_default_alt>;
	pinctrl-names = "default";
};
